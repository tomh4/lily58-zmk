/ {
    split_inputs {
        #address-cells = <1>;
        #size-cells = <0>;

        pimoroni_pim447: pimoroni_pim447@0 {
            compatible = "zmk,input-split";
            reg = <0>;
        };
    };

    pimoroni_pim447_listener {
		compatible = "zmk,input-listener";
		device = <&pimoroni_pim447>;
        input-processors = <&zip_xy_transform (INPUT_TRANSFORM_XY_SWAP | INPUT_TRANSFORM_Y_INVERT)>, <&zip_xy_scaler 5 3>;
	};
};