#include "lily58.dtsi"

/ {
    split_inputs {
        #address-cells = <1>;
        #size-cells = <0>;

        pimoroni_pim447: pimoroni_pim447@0 {
            compatible = "zmk,input-split";
            reg = <0>;
        };
    };

    pimoroni_pim447_listener: pimoroni_pim447_listener {
		compatible = "zmk,input-listener";
		device = <&pimoroni_pim447>;
        status = "disabled";
	};
};
&i2c0 {
    status = "okay";

    compatible = "nordic,nrf-twi";
    pinctrl-0 = <&i2c0_default>;
    pinctrl-1 = <&i2c0_sleep>;
    pinctrl-names = "default", "sleep";
    clock-frequency = <400000>;

    pimoroni_pim447: zmk_pimoroni_pim447@0a {
        compatible = "zephyr,input-device", "zmk,pimoroni-pim447";
        reg = <0x0A>;
		int-gpios = <&gpio0 8 (GPIO_ACTIVE_LOW | GPIO_PULL_UP)>;
        automouse-layer = <3>;
    };
};
pimoroni_pim447 {
    device = <&pimoroni_pim447>;
    input-processors = <&zip_xy_transform (INPUT_TRANSFORM_XY_SWAP | INPUT_TRANSFORM_Y_INVERT)>, <&zip_xy_scaler 5 3>;
};
